## drivers/media/platform/sunxi/sun8i-tvd/Kconfig
```kconfig
# SPDX-License-Identifier: GPL-2.0-only
config VIDEO_SUN8I_TV_DECODER
	tristate "Allwinner TV Decoder driver"
	depends on VIDEO_DEV
	depends on ARCH_SUNXI || COMPILE_TEST
	depends on COMMON_CLK && OF
	depends on PM
	select VIDEOBUF2_DMA_CONTIG
	help
	   Support for the Allwinner TV decoder unit.
	   To compile this driver as a module choose m here.
```

## drivers/media/platform/sunxi/sun8i-ve/Kconfig
```kconfig
# SPDX-License-Identifier: GPL-2.0-only
config VIDEO_SUN8I_VIDEO_ENGINE
	tristate "Allwinner video codec"
	depends on VIDEO_DEV
	depends on ARCH_SUNXI || COMPILE_TEST
	depends on COMMON_CLK && OF
	depends on PM
	select VIDEOBUF2_DMA_CONTIG
	help
	   Support for the Allwinner video engine unit.
	   To compile this driver as a module choose m here.
```
