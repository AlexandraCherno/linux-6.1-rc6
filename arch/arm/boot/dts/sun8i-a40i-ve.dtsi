/ {
	/delete-node/ video-codec@1c0e000;

	ve: video-engine@1c0e000 {
		compatible = "allwinner,sunxi-cedar-ve";
		reg = <0x01c0e000 0x1000>,
			<0x01c00000 0x10>,
			<0x01c20000 0x800>;
		clocks = <&ccu CLK_BUS_VE>, <&ccu CLK_VE>,
			<&ccu CLK_DRAM_VE>;
		clock-names = "ahb", "mod", "ram";
		resets = <&ccu RST_BUS_VE>;
		interrupts = <GIC_SPI 53 IRQ_TYPE_LEVEL_HIGH>;
		allwinner,sram = <&ve_sram 1>;
	};
};
